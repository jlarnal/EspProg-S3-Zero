## components/serial_handler/Kconfig
```kconfig
menu "Serial Handler Configuration"

    config SERIAL_HANDLER_GPIO_BOOT
        int "GPIO pin for the BOOT signal"
        default 4
        help
            GPIO pin connected to target's BOOT signal (active low)

    config SERIAL_HANDLER_GPIO_RST
        int "GPIO pin for the RESET signal"
        default 7
        help
            GPIO pin connected to target's RESET signal (active low)

    config SERIAL_HANDLER_GPIO_RXD
        int "GPIO pin for the RxD signal"
        default 6
        help
            GPIO pin for UART receive (RxD) from target

    config SERIAL_HANDLER_GPIO_TXD
        int "GPIO pin for the TxD signal"
        default 5
        help
            GPIO pin for UART transmit (TxD) to target

    config SERIAL_HANDLER_TXD_RELEASE_WHEN_IDLE
        bool "Release TxD to high-impedance when idle"
        default n
        help
            When enabled, the UART TxD line to the target is driven push-pull only
            while a programming/monitor session is active, and released to a true
            high-impedance state when idle. This lets a target repurpose its RX pin
            at runtime (e.g. as a display control line) without the dormant bridge
            holding it. Release is triggered by the target's reset-to-run transition
            (the reboot esptool issues at the end of a session), with an inactivity
            timeout as a backstop. TxD is never open-drain.

    config SERIAL_HANDLER_TXD_IDLE_MS
        int "TxD idle backstop timeout (ms)"
        depends on SERIAL_HANDLER_TXD_RELEASE_WHEN_IDLE
        default 3000
        help
            Backstop only: if no reset-to-run is observed (e.g. esptool
            --after no_reset, a terminal that just closes, or raw UART use), release
            TxD to Hi-Z after this many milliseconds of no host->target traffic.
            Must comfortably exceed the longest in-session silent gap, such as a
            flash-erase wait.

endmenu
```

## components/status_led/Kconfig
```kconfig
menu "Status LED Configuration"

    config STATUS_LED_WS2812
        bool "Use a WS2812 (NeoPixel) RGB LED for status"
        default n
        help
            Drive a single addressable WS2812 RGB LED as the status indicator
            instead of the three discrete GPIO activity LEDs. The color encodes
            the bridge mode: solid green = idle (no host), breathing green =
            ready, blue = flashing, purple = JTAG/SWD debug, fast red blink =
            fatal error; brief blue/cyan blips show bridge<->target traffic.

    config STATUS_LED_GPIO
        int "WS2812 data GPIO"
        depends on STATUS_LED_WS2812
        default 21
        help
            GPIO connected to the WS2812 data-in. On the Waveshare ESP32-S3-Zero
            the onboard RGB LED is on GPIO21.

    config STATUS_LED_BRIGHTNESS
        int "WS2812 brightness percent (1-100)"
        depends on STATUS_LED_WS2812
        range 1 100
        default 20
        help
            Global brightness scaling applied to every color. WS2812s are very
            bright; 20% is usually plenty for an indicator.

endmenu
```

## components/wireless/Kconfig
```kconfig
menu "Wireless serial (RFC2217)"

    config WIRELESS_SERIAL
        bool "Enable wireless serial bridge (RFC2217 over WiFi STA)"
        default n
        help
            Expose the target UART over WiFi as an RFC2217 server, armed by a
            double-click on the onboard BOOT button. Off by default.

    config WIRELESS_RFC2217_PORT
        int "RFC2217 TCP port"
        default 3333
        depends on WIRELESS_SERIAL

    config WIRELESS_MDNS_HOSTNAME
        string "mDNS hostname (without .local)"
        default "espprog"
        depends on WIRELESS_SERIAL

    config WIRELESS_ARM_GPIO
        int "Arm button GPIO (onboard BOOT)"
        default 0
        depends on WIRELESS_SERIAL

    config WIRELESS_SELFTEST
        bool "Run wifi.txt parser self-test at boot (logs PASS/FAIL)"
        default n
        depends on WIRELESS_SERIAL

endmenu
```
